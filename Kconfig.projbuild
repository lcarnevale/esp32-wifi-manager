## Kconfig.projbuild
```kconfig
menu "WiFi Manager Config"

    config LOGGING_TAG
        string "Logging TAG"
        default "WIFI_MANAGER"
        help
            The TAG string that identifies the running logging system.

    config WIFI_SSID
        string "WiFi SSID"
        default "WRITE-HERE-YOUR-SSID"

    config WIFI_PASS
        string "WiFi Password"
        default "WRITE-HERE-YOUR-SSID-PASSWORD"

    config WIFI_MAXIMUM_RETRY
        string "Maximum Retry"
        default 5

endmenu
```
